## Kconfig
```kconfig
# SPDX-License-Identifier: MIT

config PLANCK_LED_CONTROL
	bool "Web-controlled LED + status indicator (planck_left)"
	depends on !ZMK_SPLIT || ZMK_SPLIT_ROLE_CENTRAL
	select RAW_HID
	help
	  Drives the three onboard GPIO LEDs from the host over Raw HID
	  (usage page 0xFF60) and, optionally, shows battery / connection
	  status. Intended for the planck_left board over USB.

if PLANCK_LED_CONTROL

config PLANCK_LED_STATUS
	bool "Also show battery / connection status on the LEDs"
	default y
	help
	  When enabled, battery level and BLE/USB connection changes briefly
	  flash a color on the LEDs, then the LEDs return to the state last set
	  by the host over Raw HID. Disable to make the LEDs purely host-driven.

config PLANCK_LED_STATUS_BLINK_MS
	int "Status flash duration in milliseconds"
	default 1200
	depends on PLANCK_LED_STATUS

endif # PLANCK_LED_CONTROL
```

## config/boards/arm/planck/Kconfig.defconfig
```kconfig
# Electronut Labs Papyr board configuration

# Copyright (c) 2020 The ZMK Contributors
# SPDX-License-Identifier: MIT

if BOARD_PLANCK_LEFT

config ZMK_KEYBOARD_NAME
		default "PlanckBoy L"
endif

if BOARD_PLANCK_RIGHT

config ZMK_KEYBOARD_NAME
		default "PlanckBoy R"
endif

if BOARD_PLANCK_LEFT || BOARD_PLANCK_RIGHT

config BT_CTLR
		default BT

if USB

config USB_NRFX
    default y

config USB_DEVICE_STACK
    default y

endif # USB

endif 
```

## config/boards/arm/planck/Kconfig.planck_left_r1
```kconfig
# SPDX-License-Identifier: MIT

config BOARD_PLANCK_LEFT_R1
    select SOC_NRF52840_QIAA
    imply RETAINED_MEM
    imply RETENTION
    imply RETENTION_BOOT_MODE
```

## config/boards/arm/planck/board.yml
```yaml
boards:
  - name: planck_left
    vendor: modifier_key
    socs:
      - name: nrf52840
  - name: planck_right
    vendor: modifier_key
    socs:
      - name: nrf52840
  - name: planck_left_r1
    vendor: modifier_key
    socs:
      - name: nrf52840
  - name: planck_right_r1
    vendor: modifier_key
    socs:
      - name: nrf52840
  - name: planck_left_r2
    vendor: modifier_key
    socs:
      - name: nrf52840
  - name: planck_right_r2
    vendor: modifier_key
    socs:
      - name: nrf52840
```

## config/boards/arm/planck/planck_left_r2_defconfig
```kconfig
# SPDX-License-Identifier: MIT

CONFIG_ZMK_EXT_POWER=y
CONFIG_LOG_PROCESS_THREAD_STARTUP_DELAY_MS=4000
CONFIG_SPI=y
CONFIG_ARM_MPU=y
CONFIG_PINCTRL=y
CONFIG_ZMK_STUDIO=y
CONFIG_ZMK_STUDIO_LOCKING=n
CONFIG_GPIO=y
CONFIG_USE_DT_CODE_PARTITION=y
CONFIG_BUILD_OUTPUT_UF2=y
CONFIG_MPU_ALLOW_FLASH_WRITE=y
CONFIG_NVS=y
CONFIG_SETTINGS_NVS=y
CONFIG_FLASH=y
CONFIG_FLASH_PAGE_LAYOUT=y
CONFIG_FLASH_MAP=y
CONFIG_ZMK_USB=y
CONFIG_ZMK_BLE=y
CONFIG_EC11=y
CONFIG_EC11_TRIGGER_GLOBAL_THREAD=y
CONFIG_ZMK_BATTERY_REPORTING=y
CONFIG_RGBLED_WIDGET=y
CONFIG_RGBLED_WIDGET_BATTERY_SHOW_SELF=y
CONFIG_RGBLED_WIDGET_INTERVAL_MS=1200
CONFIG_RGBLED_WIDGET_CONN_SHOW_USB=y
# One LED at a time: 1 red, 2 green, 4 blue.
CONFIG_RGBLED_WIDGET_BATTERY_COLOR_HIGH=2
CONFIG_RGBLED_WIDGET_BATTERY_COLOR_MEDIUM=4
CONFIG_RGBLED_WIDGET_BATTERY_COLOR_LOW=1
CONFIG_RGBLED_WIDGET_BATTERY_COLOR_CRITICAL=1
CONFIG_RGBLED_WIDGET_BATTERY_COLOR_MISSING=1
CONFIG_RGBLED_WIDGET_CONN_COLOR_CONNECTED=4
CONFIG_RGBLED_WIDGET_CONN_COLOR_ADVERTISING=2
CONFIG_RGBLED_WIDGET_CONN_COLOR_DISCONNECTED=1
CONFIG_RGBLED_WIDGET_CONN_COLOR_USB=4
```
