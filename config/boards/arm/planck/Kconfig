## config/boards/arm/planck/Kconfig
```kconfig
config BOARD_ENABLE_DCDC
    bool "Enable DCDC mode"
    select SOC_DCDC_NRF52X
    default y
config BOARD_ENABLE_DCDC_HV
    bool "Enable DCDC mode"
    select SOC_DCDC_NRF52X
    default y
```

## config/boards/arm/planck/Kconfig.planck_left
```kconfig
# Copyright (c) 2020 The ZMK Contributors
# SPDX-License-Identifier: MIT

config BOARD_PLANCK_LEFT
		select SOC_NRF52840_QIAA
		imply RETAINED_MEM
		imply RETENTION
		imply RETENTION_BOOT_MODE
```

## config/west.yml
```yaml
manifest:
  remotes:
    - name: zmk
      url-base: https://github.com/zmkfirmware
    - name: yangxing
      url-base: https://github.com/yangxing844
    - name: caksoylar  # <-- new entry
      url-base: https://github.com/caksoylar
  projects:
    - name: zmk
      remote: zmk
      revision: v0.3
      import: app/west.yml
    - name: zmk-tog-io
      remote: yangxing
      revision: master
    - name: zmk-rgbled-widget  # <-- new entry
      remote: caksoylar
      revision: main
  self:
    path: config
```
